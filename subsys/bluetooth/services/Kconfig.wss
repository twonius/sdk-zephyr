## subsys/bluetooth/services/Kconfig.wss
```kconfig
# Bluetooth GATT Weight Scale service

# Copyright (c) 2018 Nordic Semiconductor ASA
# SPDX-License-Identifier: Apache-2.0

menuconfig BT_WSS
	bool "GATT Weight Scale service"

if BT_WSS

choice BT_WSS_DEFAULT_PERM
	prompt "Default permissions used for WSS characteristics"
	default BT_WSS_DEFAULT_PERM_RW
	help
	  Default permissions for WSS characteristic attributes
	  used when no permission is set for the report.
	  Used also for boot reports.

config BT_WSS_DEFAULT_PERM_RW
	bool "Read and write allowed"

config BT_WSS_DEFAULT_PERM_RW_ENCRYPT
	bool "Require encryption for access"

config BT_WSS_DEFAULT_PERM_RW_AUTHEN
	bool "Require encryption and authentication for access"

endchoice

module = BT_WSS
module-str = WSS
source "subsys/logging/Kconfig.template.log_config"

endif # BT_WSS
```
